## boards/xtensa/wemos_s2_mini/Kconfig.board
```kconfig
# Copyright (c) 2023 Espressif Systems (Shanghai) Co., Ltd.
# SPDX-License-Identifier: Apache-2.0

config BOARD_WEMOS_S2_MINI
	bool "Wemos S2 mini Board"
	depends on SOC_SERIES_ESP32S2

choice SOC_PART_NUMBER
	default SOC_ESP32S2_FN4R2
endchoice
```

## boards/xtensa/wemos_s2_mini/Kconfig.defconfig
```kconfig
# Wemos S2 mini board configuration

# Copyright (c) 2021 Espressif Systems (Shanghai) Co., Ltd.
# SPDX-License-Identifier: Apache-2.0

config BOARD
	default "wemos_s2_mini"
	depends on BOARD_WEMOS_S2_MINI

config ENTROPY_GENERATOR
	default y

config HEAP_MEM_POOL_SIZE
	default 32768 if WIFI
	default 4096
```
